/dts-v1/;
/plugin/;

/ {
	compatible = "allwinner,sun4i-a10";

	fragment@0 {
		target = <&pio>;
		__overlay__ {
			i2s_pins: i2s {
				pins = "PB5", "PB6", "PB7", "PB8", "PB9", "PB10", "PB11", "PB12";
				function = "i2s";
			};
		};
	};

	fragment@1 {
		target = <&i2s0>;
		__overlay__ {
			pinctrl-names = "default";
			pinctrl-0 = <&i2s_pins>;
			status = "okay";
		};
	};
};
