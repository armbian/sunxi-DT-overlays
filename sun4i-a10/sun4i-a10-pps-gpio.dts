/dts-v1/;
/plugin/;

/ {
	compatible = "allwinner,sun4i-a10";

	fragment@0 {
		target = <&pio>;
		__overlay__ {
			pps_pin: pps-pin {
				pins = "PI15";
				function = "gpio_in";
			};
		};
	};

	fragment@1 {
		target-path = "/";
		__overlay__ {
			pps {
				compatible = "pps-gpio";
				pinctrl-names = "default";
				pinctrl-0 = <&pps_pin>;
				gpios = <&pio 8 15 0>;  /* PI15 */
				status = "okay";
			};
		};
	};
};
