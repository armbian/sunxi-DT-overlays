/dts-v1/;
/plugin/;

/ {
	compatible = "allwinner,sun4i-a10";

	fragment@0 {
		target-path = "/aliases";
		__overlay__ {
			spi0 = "/soc@01c00000/spi@01c05000";
		};
	};

	fragment@1 {
		target = <&spi0>;
		__overlay__ {
			status = "okay";
			pinctrl-names = "default", "default";
			pinctrl-0 = <&spi0_pins_a>;
			pinctrl-1 = <&spi0_cs0_pins_a>;
		};
	};
};
