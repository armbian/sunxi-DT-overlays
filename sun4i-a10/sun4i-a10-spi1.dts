/dts-v1/;
/plugin/;

/ {
	compatible = "allwinner,sun4i-a10";

	fragment@0 {
		target-path = "/aliases";
		__overlay__ {
			spi1 = "/soc@01c00000/spi@01c06000";
		};
	};

	fragment@1 {
		target = <&spi1>;
		__overlay__ {
			status = "okay";
			pinctrl-names = "default";
			pinctrl-0 = <&spi1_pins_a>, <&spi1_cs0_pins_a>;
		};
	};
};
