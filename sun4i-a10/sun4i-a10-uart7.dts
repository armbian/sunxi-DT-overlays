/dts-v1/ /plugin/;

/ {
	compatible = "allwinner,sun4i-a10";

	fragment@0 {
		target-path = "/aliases";
		__overlay__ {
			serial7 = "/soc@01c00000/serial@01c29c00";
		};
	};

	fragment@1 {
		target = <&uart7>;
		 __overlay__ {
			pinctrl-names = "default";
			pinctrl-0 = <&uart7_pins_a>;
			status = "okay";
		};
	};
};
