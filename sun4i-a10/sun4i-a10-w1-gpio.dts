/dts-v1/;
/plugin/;

/ {
	compatible = "allwinner,sun4i-a10";

	fragment@0 {
		target = <&pio>;
		__overlay__ {
			w1_pin: w1-pin {
				pins = "PI15";
				function = "gpio_in";
			};
		};
	};

	fragment@1 {
		target-path = "/";
		__overlay__ {
			onewire {
				compatible = "w1-gpio";
				pinctrl-names = "default";
				pinctrl-0 = <&w1_pin>;
				gpios = <&pio 8 15 0>; /* PI15 */
				status = "okay";
			};
		};
	};
};
