/dts-v1/;
/plugin/;

/ {
	compatible = "allwinner,sun50i-h5";

	fragment@0 {
		target = <&ir>;
		__overlay__ {
			pinctrl-names = "default";
			pinctrl-0 = <&ir_pins_a>;
			status = "okay";
		};
	};
};
