/dts-v1/;
/plugin/;

/ {
	compatible = "allwinner,sun5i-a13";

	fragment@0 {
		target-path = "/aliases";
		__overlay__ {
			uart1 = "/soc@01c00000/serial@01c28400";
		};
	};

	fragment@1 {
		target = <&uart1>;
		 __overlay__ {
			pinctrl-names = "default";
			pinctrl-0 = <&uart1_pins_a>;
			status = "okay";
		};
	};
};
