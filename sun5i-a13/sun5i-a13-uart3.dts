/dts-v1/;
/plugin/;

/ {
	compatible = "allwinner,sun5i-a13";

	fragment@0 {
		target-path = "/aliases";
		__overlay__ {
			uart3 = "/soc@01c00000/serial@01c28c00";
		};
	};

	fragment@1 {
		target = <&uart3>;
		 __overlay__ {
			pinctrl-names = "default";
			pinctrl-0 = <&uart3_pins_a>;
			status = "okay";
		};
	};
};
