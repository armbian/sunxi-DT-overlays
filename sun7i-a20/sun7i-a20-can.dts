/dts-v1/;

/ {
	compatible = "allwinner,sun7i-a20";

	fragment@0 {
		target = < 0xffffffff >;

		__overlay__ {
			pinctrl-names = "default";
			pinctrl-0 = < 0xffffffff >;
			status = "okay";
		};
	};

	__fixups__ {
		can0 = "/fragment@0:target:0";
		can_ph_pins = "/fragment@0/__overlay__:pinctrl-0:0";
	};
};
