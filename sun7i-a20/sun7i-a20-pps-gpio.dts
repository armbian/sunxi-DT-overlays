/dts-v1/;
/plugin/;

/ {
	compatible = "allwinner,sun7i-a20";

	fragment@0 {
		target = <&pio>;
		__overlay__ {
			pps_pins: pps-pins {
				pins = "PI15";
				function = "gpio_in";
			};
		};
	};

	fragment@1 {
		target-path = "/";
		__overlay__ {
			pps0 {
				compatible = "pps-gpio";
				pinctrl-names = "default";
				pinctrl-0 = <&pps_pins>;
				gpios = <&pio 8 15 0>;  /* PI15 */
				status = "okay";
			};
		};
	};
};
