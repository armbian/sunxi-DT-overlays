/dts-v1/;
/plugin/;

/ {
	compatible = "allwinner,sun7i-a20";

	fragment@0 {
		target-path = "/aliases";
		__overlay__ {
			serial6 = "/soc@01c00000/serial@01c29800";
		};
	};

	fragment@1 {
		target = <&uart6>;
		 __overlay__ {
			pinctrl-names = "default";
			pinctrl-0 = <&uart6_pins_a>;
			status = "okay";
		};
	};
};
