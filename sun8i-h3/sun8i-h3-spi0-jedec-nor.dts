/dts-v1/ /plugin/;

/ {
	compatible = "allwinner,sun8i-h3";

	fragment@0 {
		target-path = "/aliases";
		__overlay__ {
			spi0 = "/soc/spi@01c68000";
		};
	};

	fragment@1 {
		target = <&spi0>;
		__overlay__ {
			status = "okay";
			#address-cells = <1>;
			#size-cells = <0>;
			spiflash@0 {
				compatible = "jedec,spi-nor";
				status = "okay";
				reg = <0>;
				spi-max-frequency = <1000000>;
			};
		};
	};
};
